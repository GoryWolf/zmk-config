## config/boards/shields/nvc_gw/Kconfig.shield
```kconfig
# Copyright (c) 2022 The ZMK Contributors
# SPDX-License-Identifier: MIT

config SHIELD_NVC_GW
    def_bool $(shields_list_contains,nvc_gw)
```

## config/boards/shields/nvc_mario/Kconfig.shield
```kconfig
# Copyright (c) 2022 The ZMK Contributors
# SPDX-License-Identifier: MIT

config SHIELD_NVC_MARIO
    def_bool $(shields_list_contains,nvc_mario)
```

## config/boards/shields/nvc_slideshow/Kconfig.shield
```kconfig
# Copyright (c) 2022 The ZMK Contributors
# SPDX-License-Identifier: MIT

config SHIELD_NVC_SLIDESHOW
    def_bool $(shields_list_contains,nvc_slideshow)
```

## config/boards/shields/nvc_urchin/Kconfig.shield
```kconfig
# Copyright (c) 2022 The ZMK Contributors
# SPDX-License-Identifier: MIT

config SHIELD_NICE_VIEW_CUSTOM
    def_bool $(shields_list_contains,nvc_urchin)
```

## config/west.yml
```yaml
manifest:
  remotes:
    # - name: yangxing
    #   url-base: https://github.com/yangxing844
    # - name: badjeff
    #   url-base: https://github.com/badjeff
    - name: zmkofficial
      url-base: https://github.com/zmkfirmware
    - name: gorywolf
      url-base: https://github.com/gorywolf
  projects:
    - name: zmk
      remote: zmkofficial
      revision: main
      import: app/west.yml
    # - name: zmk-pmw3610-driver
    #   remote: badjeff
    #   revision: main
    # - name: zmk-split-peripheral-input-relay
    #   remote: badjeff
    #   revision: main
    # - name: zmk-input-behavior-listener
    #   remote: badjeff
    #   revision: main
    # - name: zmk-lpm009m360a-driver
    #   remote: gorywolf
    #   revision: master
  self:
    path: config
```
